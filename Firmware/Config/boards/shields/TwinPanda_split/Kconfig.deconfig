## Firmware/Config/boards/shields/TwinPanda_split/Kconfig.deconfig
```kconfig
if SHIELD_BONAZZA_SPLIT_LEFT || SHIELD_BONAZZA_SPLIT_RIGHT
config ZMK_KEYBOARD_NAME
    default "BonazzaSplit"
endif
```

## Firmware/Config/west.yml
```yaml
manifest:
  remotes:
    # Definisce dove si trova il codice sorgente ufficiale
    - name: zmkfirmware
      url-base: https://github.com/zmkfirmware
  projects:
    # Ordina al sistema di scaricare ZMK
    - name: zmk
      remote: zmkfirmware
      revision: main
      import: app/west.yml
  self:
    # Dice al sistema che QUESTA repository (la tua) contiene la configurazione
    path: config
```

## config/boards/shields/TwinPanda_split/Kconfig.shield
```kconfig
config SHIELD_BONAZZA_SPLIT_LEFT
    def_bool $(shields_list_contains,bonazza_split_left)

config SHIELD_BONAZZA_SPLIT_RIGHT
    def_bool $(shields_list_contains,bonazza_split_right)
```

## config/boards/shields/bonazza_split/Kconfig.shield
```kconfig
config SHIELD_BONAZZA_SPLIT_LEFT
    def_bool $(shields_list_contains,bonazza_split_left)
    select I2C

config SHIELD_BONAZZA_SPLIT_RIGHT
    def_bool $(shields_list_contains,bonazza_split_right)
    select I2C
```
